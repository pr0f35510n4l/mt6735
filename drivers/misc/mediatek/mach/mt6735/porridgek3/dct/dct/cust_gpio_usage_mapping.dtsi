/*
 * Generated by MTK SP Drv_CodeGen Version 03.13.6	for MT6753. Copyright MediaTek Inc. (C) 2013.
 * Wed Jan 11 12:19:51 2017
 * Do Not Modify the File.
 */

/********************
 * GPIO USAGE MAPPING DTSI File
****************/

&gpio_usage_mapping {
	GPIO_SIM2_SCLK = <160>;
	GPIO_SIM2_SRST = <161>;
	GPIO_SIM2_SIO = <162>;
	GPIO_SIM1_SCLK = <163>;
	GPIO_SIM1_SRST = <164>;
	GPIO_SIM1_SIO = <165>;
};
