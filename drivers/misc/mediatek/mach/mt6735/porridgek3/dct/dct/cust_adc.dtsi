/*
 * Generated by MTK SP Drv_CodeGen Version 03.13.6	for MT6753. Copyright MediaTek Inc. (C) 2013.
 * Wed Jan 11 12:19:51 2017
 * Do Not Modify the File.
 */

/********************************************
 *ADC DTSI File
********************************************/

&auxadc {
	adc_channel@ {
		compatible = "mediatek,adc_channel";
		mediatek,temperature0 = <0>;
		mediatek,temperature1 = <1>;
		mediatek,adc_fdd_rf_params_dynamic_custom_ch = <12>;
		status = "okay";
	};
};
